## Kconfig
```kconfig
# This is template Kconfig file

config MCUX_COMPONENT_middleware.pngdec
    bool "PNG decoder"
    default n
    help
        Enable middleware.pngdec component

config USE_PNGDEC_DRIVER
    bool "Use the SDK pngdec driver for HW acceleration"
    default n
    help
        No prefix in generated macro
```
